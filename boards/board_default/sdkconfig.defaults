## boards/board_default/sdkconfig.defaults
```kconfig
# Rust requires typical heap and stack size adjustments
CONFIG_ESP_SYSTEM_EVENT_QUEUE_SIZE=32
CONFIG_ESP_SYSTEM_EVENT_TASK_STACK_SIZE=4096
CONFIG_MAIN_TASK_STACK_SIZE=10240

# Enable standard library features and filesystem support
CONFIG_PARTITION_TABLE_CUSTOM=y
CONFIG_PARTITION_TABLE_CUSTOM_FILENAME="partitions.csv"
CONFIG_PARTITION_TABLE_FILENAME="partitions.csv"

# Wi-Fi and TCP/IP stack configuration
CONFIG_ESP32_WIFI_AMPDU_TX_ENABLED=y
CONFIG_ESP32_WIFI_AMPDU_RX_ENABLED=y
CONFIG_LWIP_MAX_ACTIVE_TCP=16
CONFIG_LWIP_MAX_LISTENING_TCP=16

# SPI/I2C and peripheral settings
CONFIG_SPI_MASTER_IN_IRAM=y
CONFIG_I2C_MASTER_TIMEOUT_MS=100
```
