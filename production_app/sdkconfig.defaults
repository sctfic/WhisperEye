## production_app/sdkconfig.defaults
```kconfig
CONFIG_ESP_MAIN_TASK_STACK_SIZE=16384
CONFIG_ESP32_PTHREAD_TASK_STACK_SIZE_DEFAULT=16384
CONFIG_LWIP_IP_FORWARD=y
CONFIG_LWIP_IPV4_NAPT=y
CONFIG_ESP_TASK_WDT_EN=n
```

## sdkconfig.defaults
```kconfig
CONFIG_ESP_MAIN_TASK_STACK_SIZE=16384
CONFIG_ESP32_PTHREAD_TASK_STACK_SIZE_DEFAULT=16384
CONFIG_LWIP_IP_FORWARD=y
CONFIG_LWIP_IPV4_NAPT=y
CONFIG_RMT_ENABLE=y
CONFIG_RMT_TX_ENABLE=y
CONFIG_RMT_RX_ENABLE=y
```
